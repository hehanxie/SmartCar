/********************************************************
【平    台】龙丘MC9S12AC16开发板V2.0
【编    写】龙丘
【Designed】by Chiu Sir
【E-mail  】chiusir@163.com
【软件版本】V1.0
【最后更新】2009年12月15日
【相关信息参考下列地址】
【网    站】http://www.lqist.cn
【淘宝店铺】http://shop36265907.taobao.com
------------------------------------------------
【dev.env.】Code Warrior 6.2
【Target  】MC9S12AC16
【Crystal 】8.000Mhz
【busclock】16.000MHz
【pllclock】32.000MHz
*********************************************************/ 
#include "common.h"
#include "LQ12864.h"

#define HIGH  1u
#define LOW   0u

#define LED_IMAGE_WHITE       1
#define LED_IMAGE_BLACK       0

GPIO_InitTypeDef gpio_init_struct_OLED;
void init_gpio_OLED()
{
 /*
  *配置 PTC16~PTC19 为GPIO功能,输出,高电平，禁用中断
  */
  gpio_init_struct_OLED.GPIO_PTx = PTA;
  gpio_init_struct_OLED.GPIO_Pins = GPIO_Pin14|GPIO_Pin16;
  gpio_init_struct_OLED.GPIO_Dir = DIR_OUTPUT;
  gpio_init_struct_OLED.GPIO_Output = OUTPUT_H;
  gpio_init_struct_OLED.GPIO_PinControl = IRQC_DIS;
  LPLD_GPIO_Init(gpio_init_struct_OLED);
  
  gpio_init_struct_OLED.GPIO_PTx = PTB;
  gpio_init_struct_OLED.GPIO_Pins = GPIO_Pin20|GPIO_Pin21;
  LPLD_GPIO_Init(gpio_init_struct_OLED);
}

//======================================
const byte F6x8[][6] =
{
    { 0x00, 0x00, 0x00, 0x00, 0x00, 0x00 },   // sp
    { 0x00, 0x00, 0x00, 0x2f, 0x00, 0x00 },   // !
    { 0x00, 0x00, 0x07, 0x00, 0x07, 0x00 },   // "
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    { 0x14, 0x14, 0x14, 0x14, 0x14, 0x14 }    // horiz lines
};
const byte F14x16_Idx[] = 
{
	"北京龙丘邱科技开发板智能车首选液晶室温度按键次电压阈值上下左右速度方向控角大小高低读写退出限制状态：始结束正反占空比复位中关闭初化设置舵机死区前瞻距离预设检测灯比例微分积差蓝牙无线显示双"
};
const byte F14x16[] = {  
0x00,0x00,0x40,0x40,0x40,0xFE,0x00,0x00,0xFE,0x80,0x40,0x20,0x20,0x00,
0x00,0x30,0x10,0x10,0x08,0x7F,0x00,0x00,0x7F,0x40,0x40,0x40,0x78,0x00,//北0

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0x00,0x10,0x08,0x04,0x03,0x06,0x58,0x20,0x11,0x0E,0x1B,0x20,0x20,0x00,//双0
};

//======================================================
// 128X64I液晶底层驱动[8X16]字体库
// 设计者: powerint
// 描  述: [8X16]西文字符的字模数据 (纵向取模,字节倒序)
// !"#$%&'()*+,-./0123456789:;<=>?@ABCDEFGHIJKLMNOPQRSTUVWXYZ[\]^_`abcdefghijklmnopqrstuvwxyz{|}~
//======================================================
const byte F8X16[]=
{
	0x00,0x00,0x00,0x00,0x00,0x00,0x00,0x00,0x00,0x00,0x00,0x00,0x00,0x00,0x00,0x00,// 0
  0x00,0x00,0x00,0xF8,0x00,0x00,0x00,0x00,0x00,0x00,0x00,0x33,0x30,0x00,0x00,0x00,//!1
  0x00,0x10,0x0C,0x06,0x10,0x0C,0x06,0x00,0x00,0x00,0x00,0x00,0x00,0x00,0x00,0x00,//"2
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  0x00,0x06,0x01,0x01,0x02,0x02,0x04,0x04,0x00,0x00,0x00,0x00,0x00,0x00,0x00,0x00,//~94

};
//数据水平，字节垂直
byte longqiu96x64[768] = {
/* 
  0X00,0X00,0X00,0X00,0X00,0X00,0X00,0X00,0X00,0X00,0X00,0X00,0X00,0X00,0X00,0X00,
  0X00,0X00,0X00,0X00,0X00,0X00,0X00,0X00,0X00,0X00,0X80,0X80,0X80,0XC0,0XC0,0XC0,
  0XC0,0XC0,0X60,0X60,0X60,0X60,0X60,0X70,0X70,0X70,0X30,0X30,0X30,0X30,0X30,0X30,
  0X30,0X30,0X30,0X30,0X30,0X30,0X30,0X70,0X70,0X60,0X60,0X60,0X60,0X60,0XE0,0XC0,
  0XC0,0XC0,0XC0,0X80,0X80,0X80,0X80,0X00,0X00,0X00,0X00,0X00,0X00,0X00,0X00,0X00,
  0X00,0X00,0X00,0X00,0X00,0X00,0X00,0X00,0X00,0X00,0X00,0X00,0X00,0X00,0X00,0X00,
  0X00,0X00,0X00,0X00,0X00,0X00,0X00,0X00,0X00,0X00,0X80,0X80,0XC0,0XE0,0X60,0X30,
  0X38,0X18,0X1C,0X0C,0X0E,0X06,0X06,0X03,0X03,0X03,0X01,0X01,0X01,0X01,0X00,0X00,
  0X00,0X00,0X00,0X00,0X00,0X00,0X00,0X00,0X00,0X00,0X00,0X00,0X00,0X00,0X00,0X00,
  0X80,0XC0,0XC0,0X80,0X00,0X00,0X00,0X00,0X00,0X80,0XC0,0XE0,0XE0,0XE0,0X60,0X60,
  0XE0,0XE0,0XC0,0X81,0X01,0X01,0X03,0X03,0X03,0X07,0X06,0X0E,0X0C,0X1C,0X18,0X38,
  0X30,0X70,0X60,0XC0,0XC0,0X80,0X00,0X00,0X00,0X00,0X00,0X00,0X00,0X00,0X00,0X00,
  0X00,0X00,0X00,0X80,0XC0,0XF0,0X38,0X9C,0X8E,0XC7,0XC3,0XE1,0XF1,0XB0,0X00,0X00,
  0X00,0X00,0X00,0X00,0X00,0X00,0X00,0X00,0XC0,0XE0,0XF0,0X70,0X78,0XF0,0XF0,0XE0,
  0X80,0X30,0XF8,0XF8,0XF8,0XF8,0X1C,0X3C,0XFC,0XF8,0XF0,0X00,0XF0,0XF8,0XFC,0XFC,
  0XCF,0XCF,0XFF,0XFF,0XFC,0XF8,0X70,0XFC,0XFF,0XFF,0XFF,0X0F,0X01,0X70,0X70,0X30,
  0X00,0XFF,0XFF,0XFF,0XFF,0XFC,0X00,0XE0,0XE0,0XEE,0XEE,0X0E,0X00,0XC0,0XC0,0X80,
  0X80,0X00,0X00,0X00,0X01,0X03,0X03,0X06,0X0C,0X3C,0X70,0XE0,0XC0,0X00,0X00,0X00,
  0X00,0XF0,0XFE,0X1F,0X03,0X00,0X00,0X01,0X01,0X01,0X03,0X0F,0X1F,0X7F,0XFE,0XFC,
  0XF0,0XE0,0X80,0X80,0X86,0XFE,0XFC,0XF0,0X87,0X1F,0X1E,0X78,0XF8,0XF8,0X7D,0X7F,
  0X1F,0X20,0X3F,0X3F,0X3F,0X3F,0X30,0X00,0X3F,0X3F,0X3F,0X7C,0XF0,0XF9,0XFF,0XFF,
  0XFF,0XCF,0X9F,0XFF,0XFB,0XF8,0X70,0X03,0X0F,0X1F,0X1F,0X3E,0X3C,0X36,0X76,0X7E,
  0X7E,0XFF,0XFF,0XEF,0X47,0X61,0XFC,0XFF,0XFF,0XCF,0XE3,0XF8,0XFE,0XFF,0X9F,0X87,
  0XE3,0XF0,0XFE,0XFC,0X3C,0X0C,0X00,0X00,0X00,0X00,0X00,0X01,0X07,0X7F,0XFC,0X80,
  0X00,0X1F,0XFF,0XF0,0X80,0X00,0X00,0X00,0X00,0X00,0X00,0X00,0X00,0X00,0X00,0X03,
  0X1F,0X1F,0X0F,0X0F,0X07,0X03,0X03,0X01,0X00,0X00,0X00,0X00,0X00,0X00,0XC0,0XC0,
  0X00,0X00,0X00,0XC0,0XC0,0X00,0X00,0X00,0X00,0X00,0X00,0X00,0X00,0X01,0X03,0X03,
  0X03,0X03,0X03,0X01,0X01,0X00,0X00,0X80,0X00,0X00,0X00,0X00,0X00,0X80,0X80,0XC0,
  0XC0,0X80,0X01,0X01,0X00,0X00,0X00,0X00,0X00,0X00,0X01,0X03,0X03,0X03,0X07,0X0F,
  0X0F,0X0F,0X01,0X00,0X00,0X00,0X00,0X00,0X00,0X00,0X00,0X00,0XC0,0XFE,0X7F,0X03,
  0X00,0X00,0X00,0X03,0X07,0X1E,0X38,0X70,0XE0,0XC0,0X80,0X00,0X00,0X00,0X00,0X00,
  0X00,0X00,0X00,0X00,0X00,0X00,0X00,0X00,0X06,0X86,0X82,0XC2,0X62,0X3A,0X8F,0X43,
  0XFA,0XEE,0X32,0X3A,0X1A,0X02,0X02,0X02,0X00,0X00,0X00,0X00,0X00,0X1C,0X1C,0X1C,
  0X00,0X00,0X00,0X00,0X00,0X00,0X03,0XFF,0XFF,0X09,0X09,0X09,0X09,0XF9,0XF9,0X09,
  0X08,0X08,0X00,0X00,0X00,0X00,0X00,0X00,0X00,0X00,0X00,0X00,0X00,0X00,0X00,0X00,
  0X00,0X00,0X00,0X00,0X00,0X80,0XC0,0XC0,0X60,0X38,0X1C,0X0F,0X07,0X01,0X00,0X00,
  0X00,0X00,0X00,0X00,0X00,0X00,0X00,0X00,0X00,0X01,0X01,0X03,0X07,0X0E,0X0C,0X18,
  0X18,0X30,0X30,0X60,0X60,0XC0,0XC2,0XC3,0X83,0X83,0X81,0X00,0X00,0X00,0X00,0X00,
  0X01,0X03,0X03,0X07,0X07,0X06,0X0E,0X06,0X07,0X03,0X00,0X00,0X00,0X00,0X00,0X00,
  0X00,0X00,0X03,0X03,0X03,0X03,0X03,0X03,0X03,0X03,0X03,0X03,0X03,0X03,0X03,0X03,
  0X03,0X07,0X07,0X07,0X06,0X06,0X80,0X80,0X80,0XC0,0XC0,0XE0,0X60,0X70,0X30,0X38,
  0X18,0X1C,0X0E,0X06,0X07,0X03,0X01,0X00,0X00,0X00,0X00,0X00,0X00,0X00,0X00,0X00,
  0X00,0X00,0X00,0X00,0X00,0X00,0X00,0X00,0X00,0X00,0X00,0X00,0X00,0X00,0X00,0X00,
  0X00,0X00,0X00,0X00,0X00,0X00,0X00,0X01,0X01,0X01,0X03,0X03,0X03,0X07,0X06,0X06,
  0X06,0X06,0X0E,0X0C,0X0C,0X0C,0X0C,0X0C,0X0C,0X1C,0X1C,0X1C,0X18,0X18,0X18,0X18,
  0X18,0X18,0X18,0X18,0X1C,0X1C,0X1C,0X0C,0X0C,0X0C,0X0C,0X0C,0X0C,0X0C,0X06,0X06,
  0X06,0X06,0X06,0X03,0X03,0X03,0X01,0X01,0X01,0X00,0X00,0X00,0X00,0X00,0X00,0X00,
  0X00,0X00,0X00,0X00,0X00,0X00,0X00,0X00,0X00,0X00,0X00,0X00,0X00,0X00,0X00,0X00,
*/
0X00,0X00,0X00,0X00,0X00,0X00,0X00,0X00,0X00,0X00,0X00,0X00,0X00,0X00,0X00,0X00,
0X00,0X00,0X80,0X80,0XC0,0XC0,0XC0,0X60,0X60,0X60,0X30,0X30,0X30,0X38,0X18,0X18,
0X18,0X18,0X0C,0X0C,0X0C,0X0C,0X0C,0X0E,0X0E,0X0E,0X06,0X06,0X06,0X06,0X06,0X06,
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0X00,0X00,0X00,0X00,0X00,0X00,0X00,0X00,0X00,0X00,0X00,0X00,0X00,0X00,0X00,0X00,

};
byte LIBLOGO60x58[480] = { 
  0X00,0X00,0X00,0X00,0X00,0X00,0X00,0X00,0X00,0X00,0X00,0X00,0X00,0X00,0X00,0X00,
  0X00,0X00,0X00,0X00,0X00,0X00,0X00,0X00,0X00,0X00,0X00,0X00,0X00,0X00,0X00,0X00,
  0X00,0X00,0X00,0X00,0X00,0X00,0X00,0X00,0X00,0X00,0X00,0X00,0X00,0X00,0X00,0X00,
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  0X00,0X00,0X00,0X00,0X00,0X00,0X00,0X00,0X00,0X00,0X00,0X00,0X00,0X00,0X00,0X00,
}; 



 unsigned char str1[6];
 unsigned char str2[6];
 unsigned char str3[8];

 unsigned char str4[6];
 unsigned char str5[6];
 unsigned char str6[8];



void LCD_WrDat(byte data)    //数据逐位发送
{
	byte i=8;
	//LCD_CS=0;;
	LCD_DC=1;    //DC为1，表示数据发送
  LCD_SCL=0;
  //asm("nop");    
  while(i--)
  {
    if(data&0x80){LCD_SDA=1;}
    else{LCD_SDA=0;}
    LCD_SCL=1; 
    asm("nop");
		//asm("nop");            
    LCD_SCL=0;;    
    data<<=1;    
  }
	//LCD_CS=1;
}
void LCD_WrCmd(byte cmd)   //命令逐位发送
{
	byte i=8;
	
	//LCD_CS=0;;
	LCD_DC=0;;    //DC为0表示命令发送
  LCD_SCL=0;;
  //asm("nop");   
  while(i--)
  {
    if(cmd&0x80){LCD_SDA=1;}
    else{LCD_SDA=0;;}
    LCD_SCL=1;;
    asm("nop");;
		//asm("nop");             
    LCD_SCL=0;;    
    cmd<<=1;;   
  } 	
	//LCD_CS=1;
}
void LCD_Set_Pos(byte x, byte y)    //设置位置
{ 
  LCD_WrCmd(0xb0+y);       //表示从第y页开始
  LCD_WrCmd(((x&0xf0)>>4)|0x10);
  LCD_WrCmd((x&0x0f)|0x01); 
}
//************************************************
void LCD_Fill_Line(byte line,byte bmp_data)   //自加填充整行亮或暗
{
  LCD_WrCmd(0xb0+line);
  LCD_WrCmd(0x01);
  LCD_WrCmd(0x10);
  for(byte x=0;x<X_WIDTH;x++)
    LCD_WrDat(bmp_data);
}
//************************************************
void LCD_Fill(byte bmp_data)     //填充整个屏幕白或黑
{
	byte y,x;
	
	for(y=0;y<8;y++)
	{
		LCD_WrCmd(0xb0+y);
		LCD_WrCmd(0x01);
		LCD_WrCmd(0x10);
		for(x=0;x<X_WIDTH;x++)
			LCD_WrDat(bmp_data);
	}
}
void LCD_CLS(void)     //清屏
{
	byte y,x;	
	for(y=0;y<8;y++)
	{
		LCD_WrCmd(0xb0+y);
		LCD_WrCmd(0x01);
		LCD_WrCmd(0x10); 
		for(x=0;x<X_WIDTH;x++)
			LCD_WrDat(0);
	}
}
void LCD_DLY_ms(word ms)
{                         
  word a;
  while(ms)
  {
    a=1335;
    while(a--);
    ms--;
  }
  return;
}
void adjust(byte a)
{
  LCD_WrCmd(a);	//指令数据0x0000~0x003f  
}
void SetStartColumn(unsigned char d)
{
	LCD_WrCmd(0x00+d%16);		// Set Lower Column Start Address for Page Addressing Mode
						//   Default => 0x00
	LCD_WrCmd(0x10+d/16);		// Set Higher Column Start Address for Page Addressing Mode
						//   Default => 0x10
}

void SetAddressingMode(unsigned char d)
{
	LCD_WrCmd(0x20);			// Set Memory Addressing Mode
	LCD_WrCmd(d);			//   Default => 0x02
						//     0x00 => Horizontal Addressing Mode
						//     0x01 => Vertical Addressing Mode
						//     0x02 => Page Addressing Mode
}

void SetColumnAddress(unsigned char a, unsigned char b)
{
	LCD_WrCmd(0x21);			// Set Column Address
	LCD_WrCmd(a);			//   Default => 0x00 (Column Start Address)
	LCD_WrCmd(b);			//   Default => 0x7F (Column End Address)
}

void SetPageAddress(unsigned char a, unsigned char b)
{
	LCD_WrCmd(0x22);			// Set Page Address
	LCD_WrCmd(a);			//   Default => 0x00 (Page Start Address)
	LCD_WrCmd(b);			//   Default => 0x07 (Page End Address)
}

void SetStartLine(unsigned char d)
{
	LCD_WrCmd(0x40|d);			// Set Display Start Line
						//   Default => 0x40 (0x00)
}

void SetContrastControl(unsigned char d)
{
	LCD_WrCmd(0x81);			// Set Contrast Control
	LCD_WrCmd(d);			//   Default => 0x7F
}

void Set_Charge_Pump(unsigned char d)
{
	LCD_WrCmd(0x8D);			// Set Charge Pump
	LCD_WrCmd(0x10|d);			//   Default => 0x10
						//     0x10 (0x00) => Disable Charge Pump
						//     0x14 (0x04) => Enable Charge Pump
}

void Set_Segment_Remap(unsigned char d)
{
	LCD_WrCmd(0xA0|d);			// Set Segment Re-Map
						//   Default => 0xA0
						//     0xA0 (0x00) => Column Address 0 Mapped to SEG0
						//     0xA1 (0x01) => Column Address 0 Mapped to SEG127
}

void Set_Entire_Display(unsigned char d)
{
	LCD_WrCmd(0xA4|d);			// Set Entire Display On / Off
						//   Default => 0xA4
						//     0xA4 (0x00) => Normal Display
						//     0xA5 (0x01) => Entire Display On
}

void Set_Inverse_Display(unsigned char d)
{
	LCD_WrCmd(0xA6|d);			// Set Inverse Display On/Off
						//   Default => 0xA6
						//     0xA6 (0x00) => Normal Display
						//     0xA7 (0x01) => Inverse Display On
}

void Set_Multiplex_Ratio(unsigned char d)
{
	LCD_WrCmd(0xA8);			// Set Multiplex Ratio
	LCD_WrCmd(d);			//   Default => 0x3F (1/64 Duty)
}

void Set_Display_On_Off(unsigned char d)
{
	LCD_WrCmd(0xAE|d);			// Set Display On/Off
						//   Default => 0xAE
						//     0xAE (0x00) => Display Off
						//     0xAF (0x01) => Display On
}

void SetStartPage(unsigned char d)
{
	LCD_WrCmd(0xB0|d);			// Set Page Start Address for Page Addressing Mode
						//   Default => 0xB0 (0x00)
}

void Set_Common_Remap(unsigned char d)
{
	LCD_WrCmd(0xC0|d);			// Set COM Output Scan Direction
						//   Default => 0xC0
						//     0xC0 (0x00) => Scan from COM0 to 63
						//     0xC8 (0x08) => Scan from COM63 to 0
}

void Set_Display_Offset(unsigned char d)
{
	LCD_WrCmd(0xD3);			// Set Display Offset
	LCD_WrCmd(d);			//   Default => 0x00
}

void Set_Display_Clock(unsigned char d)
{
	LCD_WrCmd(0xD5);			// Set Display Clock Divide Ratio / Oscillator Frequency
	LCD_WrCmd(d);			//   Default => 0x80
						//     D[3:0] => Display Clock Divider
						//     D[7:4] => Oscillator Frequency
}

void Set_Precharge_Period(unsigned char d)
{
	LCD_WrCmd(0xD9);			// Set Pre-Charge Period
	LCD_WrCmd(d);			//   Default => 0x22 (2 Display Clocks [Phase 2] / 2 Display Clocks [Phase 1])
						//     D[3:0] => Phase 1 Period in 1~15 Display Clocks
						//     D[7:4] => Phase 2 Period in 1~15 Display Clocks
}

void Set_Common_Config(unsigned char d)
{
	LCD_WrCmd(0xDA);			// Set COM Pins Hardware Configuration
	LCD_WrCmd(0x02|d);			//   Default => 0x12 (0x10)
						//     Alternative COM Pin Configuration
						//     Disable COM Left/Right Re-Map
}

void Set_VCOMH(unsigned char d)
{
	LCD_WrCmd(0xDB);			// Set VCOMH Deselect Level
	LCD_WrCmd(d);			//   Default => 0x20 (0.77*VCC)
}

void Set_NOP(void)
{
	LCD_WrCmd(0xE3);			// Command for No Operation
}

void LCD_Init(void)        
{
  init_gpio_OLED();
  
  LCD_SCL=1;
  //LCD_CS=1;	//预制SLK和SS为高电平   	
  LCD_RST=0;
  LCD_DLY_ms(50);
  LCD_RST=1;
	
  //从上电到下面开始初始化要有足够的时间，即等待RC复位完毕
  Set_Display_On_Off(0x00);		  // Display Off (0x00/0x01)
  Set_Display_Clock(0x80);		  // Set Clock as 100 Frames/Sec
  Set_Multiplex_Ratio(0x3F);		// 1/64 Duty (0x0F~0x3F)
  Set_Display_Offset(0x00);		  // Shift Mapping RAM Counter (0x00~0x3F)
  SetStartLine(0x00);			      // Set Mapping RAM Display Start Line (0x00~0x3F)
  Set_Charge_Pump(0x04);		    // Enable Embedded DC/DC Converter (0x00/0x04)
  SetAddressingMode(0x02);		  // Set Page Addressing Mode (0x00/0x01/0x02)
  Set_Segment_Remap(0x01);		  // Set SEG/Column Mapping     0x00左右反置 0x01正常
  Set_Common_Remap(0x08);			  // Set COM/Row Scan Direction 0x00上下反置 0x08正常
  Set_Common_Config(0x10);		  // Set Sequential Configuration (0x00/0x10)
  SetContrastControl(Brightness);	// Set SEG Output Current
  Set_Precharge_Period(0xF1);		// Set Pre-Charge as 15 Clocks & Discharge as 1 Clock
  Set_VCOMH(0x40);			        // Set VCOM Deselect Level
  Set_Entire_Display(0x00);		  // Disable Entire Display On (0x00/0x01)
  Set_Inverse_Display(0x00);		// Disable Inverse Display On (0x00/0x01)  
  Set_Display_On_Off(0x01);		  // Display On (0x00/0x01)
  LCD_Fill(0x00);  //初始清屏
  LCD_Set_Pos(0,0);  
	
  /*
  LCD_WrCmd(0xae);//--turn off oled panel
  LCD_WrCmd(0x00);//---set low column address
  LCD_WrCmd(0x10);//---set high column address
  LCD_WrCmd(0x40);//--set start line address
  LCD_WrCmd(0x81);//--set contrast control register
  LCD_WrCmd(0xcf);
  LCD_WrCmd(0xa1);//--set segment re-map 95 to 0
  LCD_WrCmd(0xa6);//--set normal display
  LCD_WrCmd(0xa8);//--set multiplex ratio(1 to 64)
  LCD_WrCmd(0x3f);//--1/64 duty
  LCD_WrCmd(0xd3);//-set display offset
  LCD_WrCmd(0x00);//-not offset
  LCD_WrCmd(0xd5);//--set display clock divide ratio/oscillator frequency
  LCD_WrCmd(0x80);//--set divide ratio
  LCD_WrCmd(0xd9);//--set pre-charge period
  LCD_WrCmd(0xf1);
  LCD_WrCmd(0xda);//--set com pins hardware configuration
  LCD_WrCmd(0x12);
  LCD_WrCmd(0xdb);//--set vcomh
  LCD_WrCmd(0x40);
  LCD_WrCmd(0x8d);//--set Charge Pump enable/disable
  LCD_WrCmd(0x14);//--set(0x10) disable
  LCD_WrCmd(0xaf);//--turn on oled panel
  */
	
} 
//==============================================================
//函数名： void LCD_PutPixel(byte x,byte y)
//功能描述：绘制一个点（x,y）
//参数：真实坐标值(x,y),x的范围0～127，y的范围0～64
//返回：无
//==============================================================
void LCD_PutPixel(byte x,byte y)
{
	byte data1;  //data1当前点的数据 
	 
  LCD_Set_Pos(x,y); 
	data1 = 0x01<<(y%8); 	
	LCD_WrCmd(0xb0+(y>>3));
	LCD_WrCmd(((x&0xf0)>>4)|0x10);
	LCD_WrCmd((x&0x0f)|0x00);
	LCD_WrDat(data1); 	 	
}
//==============================================================
//函数名： void LCD_Rectangle(byte x1,byte y1,
//                   byte x2,byte y2,byte color,byte gif)
//功能描述：绘制一个实心矩形
//参数：左上角坐标（x1,y1）,右下角坐标（x2，y2）
//      其中x1、x2的范围0～127，y1，y2的范围0～63，即真实坐标值
//返回：无
//==============================================================
void LCD_Rectangle(byte x1,byte y1,byte x2,byte y2,byte gif)
{
	byte n; 
		
	LCD_Set_Pos(x1,y1>>3);
	for(n=x1;n<=x2;n++)
	{
		LCD_WrDat(0x01<<(y1%8)); 			
		if(gif == 1) 	LCD_DLY_ms(50);
	}  
	LCD_Set_Pos(x1,y2>>3);
  for(n=x1;n<=x2;n++)
	{
		LCD_WrDat(0x01<<(y2%8)); 			
		if(gif == 1) 	LCD_DLY_ms(5);
	}
	
}  
//==============================================================
//函数名：LCD_P6x8Str(byte x,byte y,byte *p)
//功能描述：写入一组标准ASCII字符串
//参数：显示的位置（x,y），y为页范围0～7，要显示的字符串
//返回：无
//==============================================================  
void LCD_P6x8Str(byte x,byte y,byte ch[])
{
  byte c=0,i=0,j=0;      
  while (ch[j]!='\0')
  {    
    c =ch[j]-32;
    if(x>126){x=0;y++;}
    LCD_Set_Pos(x,y);    
  	for(i=0;i<6;i++)     
  	  LCD_WrDat(F6x8[c][i]);  
  	x+=6;
  	j++;
  }
}

void LCD_P6x8Str2(byte x,byte y,byte ch[])
{
  byte c=0,i=0,j=0;      
  while (ch[j]!='\0')
  {    
    c =ch[j]-32;
    if(x>126){x=0;y++;}
    LCD_Set_Pos(x,y);    
  	for(i=0;i<6;i++)     
  	  LCD_WrDat(~(F6x8[c][i]));  
  	x+=6;
  	j++;
  }
}
//==============================================================
//函数名：LCD_P8x16Str(byte x,byte y,byte *p)
//功能描述：写入一组标准ASCII字符串
//参数：显示的位置（x,y），y为页范围0～7，要显示的字符串
//返回：无
//==============================================================  
void LCD_P8x16Str(byte x,byte y,byte ch[])
{
  byte c=0,i=0,j=0;
        
  while (ch[j]!='\0')
  {    
    c =ch[j]-32;
    if(x>120){x=0;y++;}
    LCD_Set_Pos(x,y);    
  	for(i=0;i<8;i++)     
  	  LCD_WrDat(F8X16[c*16+i]);
  	LCD_Set_Pos(x,y+1);    
  	for(i=0;i<8;i++)     
  	  LCD_WrDat(F8X16[c*16+i+8]);  
  	x+=8;
  	j++;
  }
}

void LCD_P8x16Str2(byte x,byte y,byte ch[])
{
  byte c=0,i=0,j=0;
        
  while (ch[j]!='\0')
  {    
    c =ch[j]-32;
    if(x>120){x=0;y++;}
    LCD_Set_Pos(x,y);    
  	for(i=0;i<8;i++)     
  	  LCD_WrDat(~F8X16[c*16+i]);
  	LCD_Set_Pos(x,y+1);    
  	for(i=0;i<8;i++)     
  	  LCD_WrDat(~F8X16[c*16+i+8]);  
  	x+=8;
  	j++;
  }
}
//输出汉字字符串
void LCD_P14x16Str(byte x,byte y,byte ch[])
{
	byte wm=0,ii = 0;
	word adder=1; 
	
	while(ch[ii] != '\0')
	{
  	wm = 0;
  	adder = 1;
  	while(F14x16_Idx[wm] > 127)
  	{
  		if(F14x16_Idx[wm] == ch[ii])
  		{
  			if(F14x16_Idx[wm + 1] == ch[ii + 1])
  			{
  				adder = wm * 14;
  				break;
  			}
  		}
  		wm += 2;			
  	}
  	if(x>118){x=0;y++;}
  	LCD_Set_Pos(x , y); 
  	if(adder != 1)// 显示汉字					
  	{
  		LCD_Set_Pos(x , y);
  		for(wm = 0;wm < 14;wm++)               
  		{
  			LCD_WrDat(F14x16[adder]);	
  			adder += 1;
  		}      
  		LCD_Set_Pos(x,y + 1); 
  		for(wm = 0;wm < 14;wm++)          
  		{
  			LCD_WrDat(F14x16[adder]);
  			adder += 1;
  		}   		
  	}
  	else			  //显示空白字符			
  	{
  		ii += 1;
      LCD_Set_Pos(x,y);
  		for(wm = 0;wm < 16;wm++)
  		{
  				LCD_WrDat(0);
  		}
  		LCD_Set_Pos(x,y + 1);
  		for(wm = 0;wm < 16;wm++)
  		{   		
  				LCD_WrDat(0);	
  		}
  	}
  	x += 14;
  	ii += 2;
	}
}

void LCD_P14x16Str2(byte x,byte y,byte ch[])
{
	byte wm=0,ii = 0;
	word adder=1; 
	
	while(ch[ii] != '\0')
	{
  	wm = 0;
  	adder = 1;
  	while(F14x16_Idx[wm] > 127)
  	{
  		if(F14x16_Idx[wm] == ch[ii])
  		{
  			if(F14x16_Idx[wm + 1] == ch[ii + 1])
  			{
  				adder = wm * 14;
  				break;
  			}
  		}
  		wm += 2;			
  	}
  	if(x>118){x=0;y++;}
  	LCD_Set_Pos(x , y); 
  	if(adder != 1)// 显示汉字					
  	{
  		LCD_Set_Pos(x , y);
  		for(wm = 0;wm < 14;wm++)               
  		{
  			LCD_WrDat(~F14x16[adder]);	
  			adder += 1;
  		}      
  		LCD_Set_Pos(x,y + 1); 
  		for(wm = 0;wm < 14;wm++)          
  		{
  			LCD_WrDat(~F14x16[adder]);
  			adder += 1;
  		}   		
  	}
  	else			  //显示空白字符			
  	{
  		ii += 1;
      LCD_Set_Pos(x,y);
  		for(wm = 0;wm < 16;wm++)
  		{
  				LCD_WrDat(0);
  		}
  		LCD_Set_Pos(x,y + 1);
  		for(wm = 0;wm < 16;wm++)
  		{   		
  				LCD_WrDat(0);	
  		}
  	}
  	x += 14;
  	ii += 2;
	}
}

//输出汉字和字符混合字符串
void LCD_Print(byte x, byte y, byte ch[])
{
	byte ch2[3];
	byte ii=0;        
	while(ch[ii] != '\0')
	{
		if(ch[ii] > 127)
		{
			ch2[0] = ch[ii];
	 		ch2[1] = ch[ii + 1];
			ch2[2] = '\0';			//汉字为两个字节
			LCD_P14x16Str(x , y, ch2);	//显示汉字
			x += 14;
			ii += 2;
		}
		else
		{
			ch2[0] = ch[ii];	
			ch2[1] = '\0';			//字母占一个字节
			LCD_P8x16Str(x , y , ch2);	//显示字母
			x += 8;
			ii+= 1;
		}
	}
} 

//==============================================================
//函数名： void Draw_BMP(byte x,byte y)
//功能描述：显示BMP图片128×64
//参数：起始点坐标(x,y),x的范围0～127，y为页的范围0～7
//返回：无
//==============================================================
void Draw_BMP(byte x0,byte y0,byte x1,byte y1,byte bmp[])
{ 	
  word ii=0;
  byte x,y;
  
  if(y1%8==0) y=y1/8;      
  else y=y1/8+1;
	for(y=y0;y<=y1;y++)
	{
		LCD_Set_Pos(x0,y);				
    for(x=x0;x<x1;x++)
	    {      
	    	LCD_WrDat(bmp[ii++]);	    	
	    }
	}
}
void Draw_LQLogo(void)
{ 	
  word ii=0;
  byte x,y;       
  
	for(y=0;y<8;y++)
	{
		LCD_Set_Pos(16,y);				
    for(x=16;x<112;x++)
	    {      
	    	LCD_WrDat(longqiu96x64[ii++]);	    	
	    }
	}
}
void Draw_LibLogo(void)
{ 	
  word ii=0;
  byte x,y;       
  
	for(y=0;y<8;y++)
	{
		LCD_Set_Pos(34,y);				
    for(x=34;x<94;x++)
	    {      
	    	LCD_WrDat(LIBLOGO60x58[ii++]);	    	
	    }
	}
}
/*void floatToInt(float fl,byte n,unsigned char x,unsigned char y)
{
   int tem1,tem2,k=1;
   unsigned char Temp_Buf[17];
   byte i;
   tem1=(int)fl;
   for(i=0;i<n;i++)
     k*=10;
   if(fl>0)
   tem2=(int)((fl-tem1)*k);
   else
   tem2=(int)((tem1-fl)*k);
   sprintf(Temp_Buf,"%d.%d\0",tem1,tem2);
   LCD_P6x8Str(x,y,Temp_Buf);
}*/
void floatToInt(float fl,byte n,byte s)
{
   int tem1,tem2,k=1;
   byte i;
   tem1=(int)fl;
   for(i=0;i<n;i++)
     k*=10;
   if(fl>0)
   tem2=(int)((fl-tem1)*k);
   else
  tem2=(int)((tem1-fl)*k);
  switch(s)
  {
  case 1:sprintf((signed char *)str1,"%d.%d\0",tem1,tem2);break;
  case 2:sprintf((signed char *)str2,"%d.%d\0",tem1,tem2);break;
  case 3:sprintf((signed char *)str3,"%d.%d\0",tem1,tem2);break;
  }
}
void floatToInt2(float fl,byte n,byte s)
{
   int tem1,tem2,k=1;
   byte i;
   tem1=(int)fl;
   for(i=0;i<n;i++)
     k*=10;
   if(fl>0)
   tem2=(int)((fl-tem1)*k);
   else
  tem2=(int)((tem1-fl)*k);
  switch(s)
  {
  case 1:sprintf((signed char *)str4,"%d.%d\0",tem1,tem2);break;
  case 2:sprintf((signed char *)str5,"%d.%d\0",tem1,tem2);break;
  case 3:sprintf((signed char *)str6,"%d.%d\0",tem1,tem2);break;
  }
}
/*****************************************************************************
 函 数 名  : LED_PrintImage
 功能描述  : 将图像显示出来
 输入参数  : UCHAR8 *pucTable     二维图像数组的地址
             USHORT16 usRowNum    二维图像的行数1~64
             USHORT16 usColumnNum 二维图像的列数1~128
 输出参数  : none
 返 回 值  : none
*****************************************************************************/
void LED_PrintImage(unsigned char *pucTable,unsigned short usRowNum, unsigned short usColumnNum)
{
    unsigned char ucData;
    unsigned short i,j,k,m,n;
   unsigned short usRowTmp;

    m = usRowNum >> 3;   //计算图片行数以8位为一组完整的组数
    n = usRowNum % 8;    //计算分完组后剩下的行数
    
    for(i = 0; i < m; i++) //完整组行扫描
    {
        LCD_Set_Pos(0,(unsigned char)i);
        usRowTmp = i << 3;    //计算当前所在行的下标                  
        for(j = 0; j < usColumnNum; j++) //列扫描        
        {
            ucData = 0;
            for(k = 0; k < 8; k++) //在i组中对这8行扫描
            {
                ucData = ucData >> 1;
                    if((pucTable + (usRowTmp + k) * usColumnNum)[j] == 255)
                    {
                       ucData = ucData | 0x80;
                    }
            }
            LCD_WrDat(ucData);
        }
    }
    
    LCD_Set_Pos(0,(unsigned char)i); //设置剩下的行显示的起始坐标
    usRowTmp = i << 3;       //计算当前所在行的下标                  
    for(j = 0; j < usColumnNum; j++) //列扫描        
    {
        ucData = 0;
        for(k = 0; k < n; k++) //对剩下的行扫描
        {
            ucData = ucData >> 1;
            
            if((pucTable + (usRowTmp + k) * usColumnNum)[j] == 255)
            {
                ucData = ucData | 0x80;
            }      
        }
        ucData = ucData >> (8 - n);
        LCD_WrDat(ucData);
    }

    return;
}

void LED_PrintImag2(unsigned char *pucTable,unsigned short usRowNum, unsigned short usColumnNum)
{
    unsigned char ucData;
    unsigned short i,j,k,m,n;
   unsigned short usRowTmp;
    
    m = usRowNum >> 3;   //计算图片行数以8位为一组完整的组数
    n = usRowNum % 8;    //计算分完组后剩下的行数
    
    for(i = 0; i < m; i++) //完整组行扫描
    {
        LCD_Set_Pos(0,(unsigned char)i);
        usRowTmp = i << 3;    //计算当前所在行的下标                  
        for(j = 0; j < usColumnNum; j+=2) //列扫描        
        {
            ucData = 0;
            for(k = 0; k < 8; k++) //在i组中对这8行扫描
            {
                ucData = ucData >> 1;
                    if((pucTable + (usRowTmp + k) * usColumnNum)[j] == 255)
                    {
                       ucData = ucData | 0x80;
                    }
                
            }
            LCD_WrDat(ucData);
        }
    }
    
    LCD_Set_Pos(0,(unsigned char)i); //设置剩下的行显示的起始坐标
    usRowTmp = i << 3;       //计算当前所在行的下标                  
    for(j = 0; j < usColumnNum; j+=2) //列扫描        
    {
        ucData = 0;
        for(k = 0; k < n; k++) //对剩下的行扫描
        {
            ucData = ucData >> 1;
                ucData = ucData >> 1;
                    if((pucTable + (usRowTmp + k) * usColumnNum)[j] == 255)
                    {
                       ucData = ucData | 0x80;
                    }
                
        }
        ucData = ucData >> (8 - n/2+1);
        LCD_WrDat(ucData);
    }

    return;
}

/*---------------------*列表移动*---------------------*/      
char Change_To_Bit[8]=
{
  0x80,0x40,0x20,0x10,0x08,0x04,0x02,0x01
};
signed char Temp_List[120];
void OLED_Write_Data(unsigned char Data)
{
	unsigned char Temp_i=8;
	LCD_DC=1;;
  LCD_SCL=0;;
  while(Temp_i--)
  {
    if(Data&0x80){LCD_SDA=1;}
    else{LCD_SDA=0;}
    LCD_SCL=1; 
    asm("nop");;
    LCD_SCL=0;;    
    Data<<=1;    
  }
}
void List_Move(signed char New_Data)
// 对数组进行移位
{
  static signed int Temp_i;
  signed int Temp_j;
  if(Temp_i<120)
    Temp_List[Temp_i]=New_Data;
  else
  {
    for(Temp_j=0;Temp_j<119;Temp_j++)
      Temp_List[Temp_j]=Temp_List[Temp_j+1];  
    Temp_List[119]=New_Data;  
  }

  if(Temp_i>=120)
    Temp_i=120;
  else
    Temp_i++; 
}
/*-------------------*显示列表图形*-------------------*/      
void Delay_temp(signed int x)
{
  signed int Temp_i,Temp_j;
  for(Temp_i=0;Temp_i<1000;Temp_i++)
    for(Temp_j=0;Temp_j<x;Temp_j++);
}

void List_Paint(void)
// 将Temp_List列表里面的数据用一整幅图画出来
{
  unsigned char Temp_i;
  unsigned char Cross;  

  for(Cross=0;Cross<6;Cross++)
  {
    LCD_Set_Pos(4,7-Cross);         //这边应该是设置图像起始的行数
    for(Temp_i=0;Temp_i<120;Temp_i++) 
    {
      if(Temp_List[Temp_i]>>3==Cross)
      {
        OLED_Write_Data(Change_To_Bit[ Temp_List[Temp_i]&0x07 ]);   
      }
      else 
      {
        OLED_Write_Data(0x00);
      }     
    }    
  }
}
void Paint_List(float New_Data,float Paint_Ave,float Paint_Margin)
// 将某个数据以列表刷新的形式显示出来
{
  unsigned char Temp_Data;
  
  Temp_Data=(signed char)(22.0/Paint_Margin*(New_Data-Paint_Ave)+26);
  List_Move(Temp_Data);
  List_Paint();
}
void Paint_Angle(float Angle)
{
  static signed int Temp_Count;
  Temp_Count=(int)(Angle);
 // Temp_Count=(int)(Angle);
  Paint_List(Temp_Count,0,25);    //已更改为80，原为25   80为显示范围
  Delay_temp(56);                 //原来是200
}

/************将浮点型数据转换为字符串************/
//fNum待变换浮点数
//str[]存储转换后数组
//dotsize 保留几位小数
int Float_To_String(float fNum,uint8 str[],int dotsize)
{
	// 定义变量
	int iSize = 0;//记录字符串长度的数
	int n = 0;//用作循环的临时变量
	uint8 *p = str;//做换向时用的指针
	uint8 *s = str;//做换向时用的指针
	char isnegative = 0;//负数标志
	unsigned long int i_predot;//小数点前的数
	unsigned long int i_afterdot;//小数点后的数
	float f_afterdot;//实数型的小数部分

	//判断是否为负数     
	if(fNum < 0)
	{
		isnegative = 1;//设置负数标志
		fNum = 0 - fNum;//将负数变为正数
	}

	i_predot = (unsigned long int)fNum;//将小数点之前的数变为整数
	f_afterdot = fNum - i_predot;//单独取出小数点之后的数
	//根据设定的要保存的小数点后的位数，将小数点后相应的位数变到小数点之前
	for(n = dotsize;n > 0;n--)
	{
	        f_afterdot = f_afterdot*10;
	}
	i_afterdot = (unsigned long int)f_afterdot;//将小数点后相应位数的数字变为整数

	//先将小数点后的数转换为字符串
	n=dotsize;
	while(i_afterdot > 0 |n > 0)
	{
		n--;
	 	str[iSize++] = i_afterdot % 10 + '0';//对10取余并变为ASCII码
	 	i_afterdot = i_afterdot / 10;//对10取商
	}
        if(dotsize==0)
        {
          str[iSize++] = ' ';//小数点是0的时候，用空格替代
        }
        else
        {
	str[iSize++] = '.';//加上小数点
        }
    //处理小数点前为0的情况。
	if(i_predot == 0)
		str[iSize++] = '0';
	//再将小数点前的数转换为字符串
	while(i_predot > 0)
	{
	 	str[iSize++] = i_predot%10 + '0';//对10取余并变为ASCII码
	 	i_predot = i_predot / 10;//对10取商
	}

	if(isnegative == 1)
	str[iSize++] = '-';//如果是负数，则在最后加上负号
	str[iSize] = '\0';//加上字符串结束标志
	
	p = str + iSize - 1;//将P指针指向字符串结束标志之前

	for( ;p - s > 0;p--,s++)//将字符串中存储的数调头   
	{   
		*s^=*p;   
		*p^=*s;   
		*s^=*p;   
	}   
	// 返回指针字符串大小 
	return iSize;
}

void LCD_Write_Float(unsigned char x,unsigned char y,float Number)
{
  signed char Temp_Buf[17];
  Float_To_String(Number,(uint8 *)Temp_Buf,3);
  LCD_P6x8Str(x,y,(uint8 *)Temp_Buf);
}

void LCD_Write_Float_Dot(unsigned char x,unsigned char y,float Number,int dotNumber)
{
  signed char Temp_Buf[17];
  Float_To_String(Number,(uint8 *)Temp_Buf,dotNumber);
  LCD_P6x8Str(x,y,(uint8 *)Temp_Buf);
}
void LCD_Write_Float_Dot_Chinese(unsigned char x,unsigned char y,float Number,int dotNumber)
{
  signed char Temp_Buf[17];
  Float_To_String(Number,(uint8 *)Temp_Buf,dotNumber);
  LCD_P8x16Str(x,y,(uint8 *)Temp_Buf);
}
//void Dis_String(unsigned char Position,signed char String[])
//{
//  switch(Position)
//  {
//    case 1:OLED_Write_String_7(2,8,String);break;	       
//    case 2:OLED_Write_String_7(2,72,String);break;	       
//    case 3:OLED_Write_String_7(4,8,String);break;	       
//    case 4:OLED_Write_String_7(4,72,String);break;	       
//    case 5:OLED_Write_String_7(6,8,String);break;	       
//    case 6:OLED_Write_String_7(6,72,String);break;	 
//    default:break;      
//  }
//}
/*******************************************************************************
 函 数 名  : LCD_PaintTSL1401_Bulk
 功能描述  : 输出二值化图像
 输入参数  : BYTE y1  起始行
             BYTE y2  结束行
             BYTE data[]  二值化图像数组
 输出参数  : none
 返 回 值  : none
*******************************************************************************/
void LCD_PaintTSL1401_Bulk(byte y1,byte y2,byte data[])    //块状型
{
  byte y,x;
	
	for(y=y1;y<=y2;y++)
	{
		LCD_WrCmd(0xb0+y);
		LCD_WrCmd(0x01);
		LCD_WrCmd(0x10);
		for(x=0;x<X_WIDTH;x++)
                  if(data[x]==0)
                    LCD_WrDat(0XFF);
                else
                  LCD_WrDat(0X00);
	}
}
/*******************************************************************************
 函 数 名  : void LCD_PaintTSL1401_Line(byte data[],float avange);
 功能描述  : 输出全值图像
 输入参数  : BYTE data[]  原值图像数组
          : FLOAT avange 阈值
 输出参数  : none
 返 回 值  : none
*******************************************************************************/
void LCD_PaintTSL1401_Line(byte data[],float avange)    //函数型
{
  LCD_CLS();
  byte temp;
//  byte x,y;
//  byte data1;
//  for(x=0;x<X_WIDTH-1;x++)   //x轴
//  {
//    y=(64-(unsigned int)(data[x]*0.05));
//    if(y>=64)
//      y=64;
//    if(y<=0)
//      y=0;
//    LCD_Set_Pos(x,y ); 
//	data1 = 0x01<<(y%8); 	
//	LCD_WrCmd(0xb0+(y>>3));
//	LCD_WrCmd(((x&0xf0)>>4)|0x10);
//	LCD_WrCmd((x&0x0f)|0x00);
//	LCD_WrDat(data1);
//  }
  for(int i=0;i<128;i++)
  {
    temp=data[i];
    if(temp>=255)
      temp=255ul;
    if(data[i]<=0)
      temp=0;
    temp=(int)(temp*0.165);
    LCD_PutPixel(i,temp);
  }
  Delay_temp(200);
}
